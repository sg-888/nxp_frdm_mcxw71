## drivers/sensor/dht22/Kconfig
```kconfig
config DHT22
    bool "DHT22 Temperature and Humidity Sensor (Project Private)"
    default n
    select GPIO
    help
      Project private driver for the DHT22 temperature and humidity sensor.
```

## dts/bindings/sensor/aosong,dht22.yaml
```yaml
description: DHT22温湿度传感器

compatible: "aosong,dht22"

properties:
  gpios:
    type: phandle-array
    required: true
    description: 数据引脚
```
